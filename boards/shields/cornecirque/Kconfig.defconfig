## boards/shields/cornecirque/Kconfig.defconfig
```kconfig
if SHIELD_CORNECIRQUE_LEFT

# Name must be less than 16 characters long!
config ZMK_KEYBOARD_NAME
    default "CorneCirqueL"

endif

if SHIELD_CORNECIRQUE_RIGHT

# Name must be less than 16 characters long!
config ZMK_KEYBOARD_NAME
    default "CorneCirqueR"

config ZMK_SPLIT_ROLE_CENTRAL
    default y

endif

if SHIELD_CORNECIRQUE_RIGHT || SHIELD_CORNECIRQUE_LEFT

config ZMK_SPLIT
    default y

config I2C
	default y

config ZMK_POINTING
    default y

endif
```
